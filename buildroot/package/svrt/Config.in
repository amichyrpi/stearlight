## buildroot/package/svrt/Config.in
```kconfig
config BR2_PACKAGE_SVRT
    bool "svrt"
    depends on BR2_USE_MMU
    depends on BR2_PACKAGE_RPI_FFMPEG
    depends on BR2_PACKAGE_LIBDRM
    depends on BR2_PACKAGE_SDL2_KMSDRM
    depends on BR2_PACKAGE_SDL2_TTF
    help
      SteamVR HEVC hardware decoder and KMSDRM receiver.

config BR2_PACKAGE_SVRT_LOCAL_PATH
    string "SVRT local source path"
    default "/svrt"
    depends on BR2_PACKAGE_SVRT
```
